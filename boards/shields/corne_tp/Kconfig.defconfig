## boards/shields/corne_tp/Kconfig.defconfig
```kconfig
# Central Side Configuration
#
# The side on which the PS/2 mouse is connected MUST be the central side.
#
# By default zmk configures the LEFT side as the central side. But most people
# want to connect their pointing devices to the RIGHT side.
#
# So, you need to define that the central side is the one to which the
# pointing device is connected to.

if SHIELD_CORNE_TP_RIGHT

config ZMK_KEYBOARD_NAME
    default "Corne TP"

config ZMK_SPLIT_ROLE_CENTRAL
    default y

endif

# Options that should be enabled on both sides
if SHIELD_CORNE_TP_LEFT || SHIELD_CORNE_TP_RIGHT

config ZMK_SPLIT
    default y

if ZMK_DISPLAY

config I2C
    default y

config SSD1306
    default y

endif # ZMK_DISPLAY

if LVGL

config LV_Z_VDB_SIZE
    default 64

config LV_DPI_DEF
    default 148

config LV_Z_BITS_PER_PIXEL
    default 1

choice LV_COLOR_DEPTH
    default LV_COLOR_DEPTH_1
endchoice

endif # LVGL

endif
```

## boards/shields/corne_tp/Kconfig.shield
```kconfig
# Copyright (c) 2020 Pete Johanson
# SPDX-License-Identifier: MIT

config SHIELD_CORNE_TP_LEFT
    def_bool $(shields_list_contains,corne_tp_left)

config SHIELD_CORNE_TP_RIGHT
    def_bool $(shields_list_contains,corne_tp_right)
```
